## CMakeLists.txt
```
# notes-matrix: native Zephyr firmware for the Arduino UNO Q's STM32U585.
# Build (from mcu/):  west build -b arduino_uno_q notes-matrix -d build
cmake_minimum_required(VERSION 3.20.0)

find_package(Zephyr REQUIRED HINTS $ENV{ZEPHYR_BASE})
project(notes_matrix LANGUAGES C)

target_sources(app PRIVATE
  src/main.c
  src/matrix.c
  src/link.c
  src/view.c
  src/mpack.c
  src/rpc.c
)
```

## west.yml
```
# West manifest for the notes-matrix firmware (STM32U585 on the Arduino UNO Q).
# Pulls Zephyr plus only the modules this board needs. The workspace is `mcu/`:
#   cd mcu && west init -l notes-matrix && west update --narrow -o=--depth=1
manifest:
  self:
    path: notes-matrix
  remotes:
    - name: zephyrproject-rtos
      url-base: https://github.com/zephyrproject-rtos
  projects:
    - name: zephyr
      remote: zephyrproject-rtos
      revision: v4.4.2
      import:
        name-allowlist:
          - cmsis
          - cmsis_6
          - hal_stm32
```

## prj.conf
```kconfig
# UART to Linux (LPUART1 <-> /dev/ttyHS1, owned by arduino-router there),
# interrupt-driven RX into a ring buffer, MessagePack-RPC on top.
CONFIG_SERIAL=y
CONFIG_UART_INTERRUPT_DRIVEN=y
CONFIG_RING_BUFFER=y

# LED matrix: charlieplexed on GPIOF, scanned from a TIM17 counter interrupt.
CONFIG_GPIO=y
CONFIG_COUNTER=y

# Boot banner and logs go to the board console (USART1, D0/D1 header pins).
CONFIG_CONSOLE=y
CONFIG_UART_CONSOLE=y
CONFIG_PRINTK=y

CONFIG_MAIN_STACK_SIZE=2048
CONFIG_HW_STACK_PROTECTION=y
```

## app.overlay
```dts
/*
 * notes-matrix devicetree additions for the arduino_uno_q board.
 *
 * - TIM17 as a counter: its top-value interrupt scans the LED matrix
 *   (same timer and prescaler as Arduino's loader).
 * - GPIOF: the 11 charlieplexed LED matrix lines PF0..PF10.
 * - LPUART1 (PG7 TX / PG8 RX, 115200 8N1, no flow control) is already enabled
 *   by the board; it is the link Linux sees as /dev/ttyHS1.
 */

&timers17 {
	status = "okay";
	st,prescaler = <4>;

	counter_matrix: counter {
		status = "okay";
	};
};

&gpiof {
	status = "okay";
};
```

## src/main.c
```c
/*
 * notes-matrix: native Zephyr firmware for the Arduino UNO Q's STM32U585.
 *
 * Shows notes-server's status on the 8x13 LED matrix. Linux reaches it through
 * arduino-router: the router owns the UART to this chip and forwards
 * MessagePack-RPC calls for the methods registered here (see rpc.h).
 */

#include <zephyr/kernel.h>
#include <zephyr/sys/printk.h>

#include "link.h"
#include "matrix.h"
#include "rpc.h"
#include "view.h"

#define FRAME_MS 40 /* 25 fps */
/* Re-register while no status arrives: the router forgets registrations
 * when it restarts, and the server may simply not be running yet. */
#define REGISTER_EVERY_MS 10000
#define STATUS_FRESH_MS   3000

static void on_status(char state, int64_t requests, int64_t uploads)
{
	view_status(state, requests, uploads, k_uptime_get_32());
}

static void on_text(const char *text, size_t len)
{
	view_text(text, len, k_uptime_get_32());
}

static void on_log(const char *msg)
{
	printk("notes-matrix: %s\n", msg);
}

static const struct rpc_callbacks callbacks = {
	.write = link_write,
	.status = on_status,
	.text = on_text,
	.log = on_log,
};

int main(void)
{
	static uint8_t frame[MATRIX_LEDS];
	uint8_t rx[64];
	int err;

	view_init();
	rpc_init(&callbacks);
	err = matrix_init();
	if (err) {
		printk("notes-matrix: LED matrix init failed (%d)\n", err);
	}
	err = link_init();
	if (err) {
		printk("notes-matrix: UART init failed (%d)\n", err);
		return 0;
	}
	printk("notes-matrix: running (%s)\n", RPC_HELLO);

	int64_t next_frame = k_uptime_get();
	int64_t next_register = 0;

	for (;;) {
		int64_t now = k_uptime_get();
		uint32_t last_status = view_last_status_ms();
		bool fresh = last_status != 0 && (uint32_t)now - last_status < STATUS_FRESH_MS;

		if (now >= next_register && !fresh) {
			rpc_register();
			next_register = now + REGISTER_EVERY_MS;
		}

		int64_t wait = next_frame - now;
		size_t n = wait > 0 ? link_read(rx, sizeof(rx), K_MSEC(wait)) : 0;

		if (n > 0) {
			rpc_feed(rx, n);
			continue;
		}
		view_render(frame, k_uptime_get_32());
		matrix_show(frame);
		next_frame += FRAME_MS;
		if (next_frame < k_uptime_get()) {
			next_frame = k_uptime_get(); /* don't try to catch up after a stall */
		}
	}
	return 0;
}
```

## src/link.c
```c
#include <zephyr/device.h>
#include <zephyr/drivers/uart.h>
#include <zephyr/kernel.h>
#include <zephyr/sys/ring_buffer.h>

#include "link.h"

static const struct device *const uart = DEVICE_DT_GET(DT_NODELABEL(lpuart1));

/* Bytes from the RX interrupt to the main loop. Overflow drops bytes; the
 * MessagePack parser resynchronises on the next valid message. */
RING_BUF_DECLARE(rx_ring, 1024);
K_SEM_DEFINE(rx_ready, 0, 1);

static void uart_isr(const struct device *dev, void *user_data)
{
	uint8_t buf[32];

	ARG_UNUSED(user_data);
	if (!uart_irq_update(dev)) {
		return;
	}
	while (uart_irq_rx_ready(dev)) {
		int n = uart_fifo_read(dev, buf, sizeof(buf));

		if (n <= 0) {
			break;
		}
		ring_buf_put(&rx_ring, buf, (uint32_t)n);
		k_sem_give(&rx_ready);
	}
}

int link_init(void)
{
	if (!device_is_ready(uart)) {
		return -ENODEV;
	}
	int err = uart_irq_callback_user_data_set(uart, uart_isr, NULL);

	if (err) {
		return err;
	}
	uart_irq_rx_enable(uart);
	return 0;
}

size_t link_read(uint8_t *buf, size_t cap, k_timeout_t timeout)
{
	size_t n = ring_buf_get(&rx_ring, buf, (uint32_t)cap);

	if (n == 0 && k_sem_take(&rx_ready, timeout) == 0) {
		n = ring_buf_get(&rx_ring, buf, (uint32_t)cap);
	}
	return n;
}

void link_write(const uint8_t *buf, size_t len)
{
	for (size_t i = 0; i < len; i++) {
		uart_poll_out(uart, buf[i]);
	}
}
```

## src/link.h
```c
/*
 * UART to Linux: LPUART1 <-> /dev/ttyHS1, which arduino-router owns on the
 * Linux side. Carries a MessagePack-RPC byte stream (see rpc.h).
 */
#pragma once

#include <stddef.h>
#include <stdint.h>
#include <zephyr/kernel.h>

/* Starts interrupt-driven reception. Returns 0 or -errno. */
int link_init(void);

/* Waits up to `timeout` for received bytes; returns how many were copied (0 on timeout). */
size_t link_read(uint8_t *buf, size_t cap, k_timeout_t timeout);

/* Sends bytes (blocking). */
void link_write(const uint8_t *buf, size_t len);
```

## src/matrix.c
```c
/*
 * LED matrix driver for the Arduino UNO Q.
 *
 * The 104 LEDs are charlieplexed on PF0..PF10: each LED sits between two of
 * the lines, lit by driving one high and the other low while every other line
 * floats (input). Only one LED is on at a time; a TIM17 interrupt every 10 us
 * moves to the next one, so the whole matrix refreshes at ~960 Hz. Brightness
 * comes from lighting an LED on only some of the 8 scans of a cycle.
 *
 * The LED -> line-pair table and the register-level switching are from
 * Arduino's loader (ArduinoCore-zephyr loader/matrix.inc, Apache-2.0,
 * Copyright (c) Arduino s.r.l. and/or its affiliated companies).
 */

#include <string.h>

#include <soc.h>
#include <zephyr/device.h>
#include <zephyr/drivers/counter.h>
#include <zephyr/drivers/gpio.h>
#include <zephyr/kernel.h>

#include "matrix.h"

#define MATRIX_LINES 11

/* {high line, low line} for LED n, row-major (n = row * 13 + column). */
static const uint8_t pins[MATRIX_LEDS][2] = {
	{0, 1}, {1, 0}, {0, 2}, {2, 0}, {1, 2}, {2, 1}, {0, 3}, {3, 0}, {1, 3}, {3, 1},
	{2, 3}, {3, 2}, {0, 4}, {4, 0}, {1, 4}, {4, 1}, {2, 4}, {4, 2}, {3, 4}, {4, 3},
	{0, 5}, {5, 0}, {1, 5}, {5, 1}, {2, 5}, {5, 2}, {3, 5}, {5, 3}, {4, 5}, {5, 4},
	{0, 6}, {6, 0}, {1, 6}, {6, 1}, {2, 6}, {6, 2}, {3, 6}, {6, 3}, {4, 6}, {6, 4},
	{5, 6}, {6, 5}, {0, 7}, {7, 0}, {1, 7}, {7, 1}, {2, 7}, {7, 2}, {3, 7}, {7, 3},
	{4, 7}, {7, 4}, {5, 7}, {7, 5}, {6, 7}, {7, 6}, {0, 8}, {8, 0}, {1, 8}, {8, 1},
	{2, 8}, {8, 2}, {3, 8}, {8, 3}, {4, 8}, {8, 4}, {5, 8}, {8, 5}, {6, 8}, {8, 6},
	{7, 8}, {8, 7}, {0, 9}, {9, 0}, {1, 9}, {9, 1}, {2, 9}, {9, 2}, {3, 9}, {9, 3},
	{4, 9}, {9, 4}, {5, 9}, {9, 5}, {6, 9}, {9, 6}, {7, 9}, {9, 7}, {8, 9}, {9, 8},
	{0, 10}, {10, 0}, {1, 10}, {10, 1}, {2, 10}, {10, 2}, {3, 10}, {10, 3}, {4, 10}, {10, 4},
	{5, 10}, {10, 5}, {6, 10}, {10, 6},
};

/* Which of the 8 scans in a cycle light an LED of each brightness. */
static const uint8_t level_mask[MATRIX_MAX + 1] = {
	0x00, 0x01, 0x11, 0x49, 0x55, 0x5b, 0x77, 0xff,
};

/* MODER bits of PF0..PF10 (2 bits per pin); PF11..PF15 are left alone. */
#define LINES_MODER_MASK ((1U << (2 * MATRIX_LINES)) - 1)

static volatile uint8_t framebuffer[MATRIX_LEDS];

static inline void all_lines_float(void)
{
	GPIOF->MODER &= ~LINES_MODER_MASK;
}

static inline void light(int led)
{
	uint32_t hi = pins[led][0];
	uint32_t lo = pins[led][1];

	GPIOF->BSRR = BIT(hi) | BIT(lo + 16);
	GPIOF->MODER |= BIT(2 * hi) | BIT(2 * lo); /* 01 = output */
}

static void scan_isr(const struct device *dev, void *user_data)
{
	static int led;
	static uint8_t scan;

	ARG_UNUSED(dev);
	ARG_UNUSED(user_data);

	all_lines_float();
	if (level_mask[framebuffer[led] & MATRIX_MAX] & BIT(scan)) {
		light(led);
	}
	if (++led == MATRIX_LEDS) {
		led = 0;
		scan = (scan + 1) & 7;
	}
}

int matrix_init(void)
{
	const struct device *gpiof = DEVICE_DT_GET(DT_NODELABEL(gpiof));
	const struct device *timer = DEVICE_DT_GET(DT_NODELABEL(counter_matrix));

	if (!device_is_ready(gpiof) || !device_is_ready(timer)) {
		return -ENODEV;
	}
	/* Through the driver once so the port clock is on and pulls are off. */
	for (int i = 0; i < MATRIX_LINES; i++) {
		int err = gpio_pin_configure(gpiof, i, GPIO_INPUT);

		if (err) {
			return err;
		}
	}

	struct counter_top_cfg top = {
		.ticks = counter_us_to_ticks(timer, 10),
		.callback = scan_isr,
		.user_data = NULL,
		.flags = 0,
	};
	int err = counter_set_top_value(timer, &top);

	if (err) {
		return err;
	}
	return counter_start(timer);
}

void matrix_show(const uint8_t frame[MATRIX_LEDS])
{
	/* Byte copies: the ISR may see a frame half old/half new for one scan,
	 * which is invisible at ~960 Hz. */
	for (int i = 0; i < MATRIX_LEDS; i++) {
		framebuffer[i] = frame[i];
	}
}
```

## src/matrix.h
```c
/* 8x13 charlieplexed LED matrix of the Arduino UNO Q. */
#pragma once

#include <stdint.h>

#define MATRIX_W    13
#define MATRIX_H    8
#define MATRIX_LEDS (MATRIX_W * MATRIX_H)
#define MATRIX_MAX  7 /* brightness levels 0..7 */

/* Configures the GPIOs and starts the scan timer. Returns 0 or -errno. */
int matrix_init(void);

/* Shows a frame of MATRIX_LEDS brightness values (row-major, 0..7). */
void matrix_show(const uint8_t frame[MATRIX_LEDS]);
```

## src/mpack.c
```c
#include "mpack.h"

#include <string.h>

#define MAX_DEPTH 8

static uint32_t be(const uint8_t *p, int n)
{
	uint32_t v = 0;

	for (int i = 0; i < n; i++) {
		v = (v << 8) | p[i];
	}
	return v;
}

/* Scans one value; returns its length, 0 if incomplete, -1 if malformed. */
static long scan(const uint8_t *p, size_t len, int depth)
{
	if (depth > MAX_DEPTH) {
		return -1;
	}
	if (len < 1) {
		return 0;
	}

	uint8_t t = p[0];
	size_t head = 1;     /* bytes before the payload / children */
	uint64_t payload = 0; /* raw bytes after the head */
	uint32_t children = 0; /* nested values after the head */

#define NEED(n) \
	do { \
		if (len < (size_t)(n)) { \
			return 0; \
		} \
	} while (0)

	if (t <= 0x7f || t >= 0xe0 || t == 0xc0 || t == 0xc2 || t == 0xc3) {
		/* fixint, nil, bool */
	} else if (t >= 0x80 && t <= 0x8f) {
		children = 2u * (t & 0x0f);
	} else if (t >= 0x90 && t <= 0x9f) {
		children = t & 0x0f;
	} else if (t >= 0xa0 && t <= 0xbf) {
		payload = t & 0x1f;
	} else {
		switch (t) {
		case 0xc4: case 0xd9: NEED(2); head = 2; payload = p[1]; break;          /* bin8, str8 */
		case 0xc5: case 0xda: NEED(3); head = 3; payload = be(p + 1, 2); break;  /* bin16, str16 */
		case 0xc6: case 0xdb: NEED(5); head = 5; payload = be(p + 1, 4); break;  /* bin32, str32 */
		case 0xc7: NEED(2); head = 3; payload = p[1]; break;                     /* ext8 */
		case 0xc8: NEED(3); head = 4; payload = be(p + 1, 2); break;             /* ext16 */
		case 0xc9: NEED(5); head = 6; payload = be(p + 1, 4); break;             /* ext32 */
		case 0xca: payload = 4; break;                                           /* float32 */
		case 0xcb: payload = 8; break;                                           /* float64 */
		case 0xcc: case 0xd0: payload = 1; break;                                /* (u)int8 */
		case 0xcd: case 0xd1: payload = 2; break;
		case 0xce: case 0xd2: payload = 4; break;
		case 0xcf: case 0xd3: payload = 8; break;
		case 0xd4: payload = 2; break;                                           /* fixext1..16 */
		case 0xd5: payload = 3; break;
		case 0xd6: payload = 5; break;
		case 0xd7: payload = 9; break;
		case 0xd8: payload = 17; break;
		case 0xdc: NEED(3); head = 3; children = be(p + 1, 2); break;            /* array16 */
		case 0xdd: NEED(5); head = 5; children = be(p + 1, 4); break;            /* array32 */
		case 0xde: NEED(3); head = 3; children = 2u * be(p + 1, 2); break;       /* map16 */
		case 0xdf: NEED(5); head = 5; children = 2u * be(p + 1, 4); break;       /* map32 */
		default: return -1;                                                      /* 0xc1 */
		}
	}
#undef NEED

	if (payload > 0xffff) {
		return -1; /* nothing this firmware accepts is that big */
	}
	size_t total = head + (size_t)payload;

	if (len < total) {
		return 0;
	}
	for (uint32_t i = 0; i < children; i++) {
		long n = scan(p + total, len - total, depth + 1);

		if (n <= 0) {
			return n;
		}
		total += (size_t)n;
	}
	return (long)total;
}

int mp_value_len(const uint8_t *buf, size_t len)
{
	long n = scan(buf, len, 0);

	return n > 0x7fff ? -1 : (int)n;
}

void mp_reader_init(struct mp_reader *r, const uint8_t *buf, size_t len)
{
	r->p = buf;
	r->end = buf + len;
	r->ok = true;
}

static bool have(struct mp_reader *r, size_t n)
{
	if (!r->ok || (size_t)(r->end - r->p) < n) {
		r->ok = false;
	}
	return r->ok;
}

bool mp_read_array(struct mp_reader *r, uint32_t *count)
{
	if (!have(r, 1)) {
		return false;
	}
	uint8_t t = *r->p;

	if (t >= 0x90 && t <= 0x9f) {
		*count = t & 0x0f;
		r->p += 1;
	} else if (t == 0xdc && have(r, 3)) {
		*count = be(r->p + 1, 2);
		r->p += 3;
	} else if (t == 0xdd && have(r, 5)) {
		*count = be(r->p + 1, 4);
		r->p += 5;
	} else {
		r->ok = false;
	}
	return r->ok;
}

bool mp_read_int(struct mp_reader *r, int64_t *value)
{
	if (!have(r, 1)) {
		return false;
	}
	uint8_t t = *r->p;
	int n;

	if (t <= 0x7f) {
		*value = t;
		r->p += 1;
		return true;
	}
	if (t >= 0xe0) {
		*value = (int8_t)t;
		r->p += 1;
		return true;
	}
	switch (t) {
	case 0xcc: case 0xd0: n = 1; break;
	case 0xcd: case 0xd1: n = 2; break;
	case 0xce: case 0xd2: n = 4; break;
	case 0xcf: case 0xd3: n = 8; break;
	default:
		r->ok = false;
		return false;
	}
	if (!have(r, 1 + (size_t)n)) {
		return false;
	}
	uint64_t u = 0;

	for (int i = 0; i < n; i++) {
		u = (u << 8) | r->p[1 + i];
	}
	if (t >= 0xd0) { /* signed: sign-extend from n bytes */
		int shift = 64 - 8 * n;

		*value = (int64_t)(u << shift) >> shift;
	} else {
		*value = (int64_t)u;
	}
	r->p += 1 + n;
	return true;
}

bool mp_read_str(struct mp_reader *r, const char **str, uint32_t *len)
{
	if (!have(r, 1)) {
		return false;
	}
	uint8_t t = *r->p;
	size_t head;

	if (t >= 0xa0 && t <= 0xbf) {
		head = 1;
		*len = t & 0x1f;
	} else if (t == 0xd9 && have(r, 2)) {
		head = 2;
		*len = r->p[1];
	} else if (t == 0xda && have(r, 3)) {
		head = 3;
		*len = be(r->p + 1, 2);
	} else {
		r->ok = false;
		return false;
	}
	if (!have(r, head + *len)) {
		return false;
	}
	*str = (const char *)r->p + head;
	r->p += head + *len;
	return true;
}

bool mp_read_nil(struct mp_reader *r)
{
	if (have(r, 1) && *r->p == 0xc0) {
		r->p += 1;
		return true;
	}
	return false;
}

bool mp_skip(struct mp_reader *r)
{
	if (!r->ok) {
		return false;
	}
	long n = scan(r->p, (size_t)(r->end - r->p), 0);

	if (n <= 0) {
		r->ok = false;
		return false;
	}
	r->p += n;
	return true;
}

void mp_writer_init(struct mp_writer *w, uint8_t *buf, size_t cap)
{
	w->buf = buf;
	w->cap = cap;
	w->len = 0;
	w->ok = true;
}

static void put(struct mp_writer *w, const void *data, size_t n)
{
	if (!w->ok || w->cap - w->len < n) {
		w->ok = false;
		return;
	}
	memcpy(w->buf + w->len, data, n);
	w->len += n;
}

static void put_be(struct mp_writer *w, uint8_t type, uint64_t v, int n)
{
	uint8_t tmp[9];

	tmp[0] = type;
	for (int i = 0; i < n; i++) {
		tmp[n - i] = (uint8_t)(v >> (8 * i));
	}
	put(w, tmp, 1 + (size_t)n);
}

void mp_write_array(struct mp_writer *w, uint32_t count)
{
	if (count <= 15) {
		uint8_t t = 0x90 | (uint8_t)count;

		put(w, &t, 1);
	} else if (count <= 0xffff) {
		put_be(w, 0xdc, count, 2);
	} else {
		put_be(w, 0xdd, count, 4);
	}
}

void mp_write_uint(struct mp_writer *w, uint64_t v)
{
	if (v <= 0x7f) {
		uint8_t t = (uint8_t)v;

		put(w, &t, 1);
	} else if (v <= 0xff) {
		put_be(w, 0xcc, v, 1);
	} else if (v <= 0xffff) {
		put_be(w, 0xcd, v, 2);
	} else if (v <= 0xffffffffu) {
		put_be(w, 0xce, v, 4);
	} else {
		put_be(w, 0xcf, v, 8);
	}
}

void mp_write_str(struct mp_writer *w, const char *str)
{
	size_t n = strlen(str);

	if (n <= 31) {
		uint8_t t = 0xa0 | (uint8_t)n;

		put(w, &t, 1);
	} else if (n <= 0xff) {
		put_be(w, 0xd9, n, 1);
	} else {
		put_be(w, 0xda, n, 2);
	}
	put(w, str, n);
}

void mp_write_nil(struct mp_writer *w)
{
	uint8_t t = 0xc0;

	put(w, &t, 1);
}
```

## src/mpack.h
```c
/*
 * Minimal MessagePack reader/writer: just what MessagePack-RPC through
 * arduino-router needs. Plain C, no allocation.
 */
#pragma once

#include <stdbool.h>
#include <stddef.h>
#include <stdint.h>

/* Length of the complete MessagePack value at the start of buf:
 * > 0 complete (bytes), 0 incomplete (need more data), < 0 malformed. */
int mp_value_len(const uint8_t *buf, size_t len);

struct mp_reader {
	const uint8_t *p;
	const uint8_t *end;
	bool ok; /* false after the first type mismatch or truncation */
};

void mp_reader_init(struct mp_reader *r, const uint8_t *buf, size_t len);
bool mp_read_array(struct mp_reader *r, uint32_t *count);
bool mp_read_int(struct mp_reader *r, int64_t *value);
/* Points *str into the buffer (not NUL-terminated). */
bool mp_read_str(struct mp_reader *r, const char **str, uint32_t *len);
/* Consumes a nil and returns true, or returns false (without error) if the next value is not nil. */
bool mp_read_nil(struct mp_reader *r);
bool mp_skip(struct mp_reader *r);

struct mp_writer {
	uint8_t *buf;
	size_t cap;
	size_t len;
	bool ok; /* false if the buffer overflowed */
};

void mp_writer_init(struct mp_writer *w, uint8_t *buf, size_t cap);
void mp_write_array(struct mp_writer *w, uint32_t count);
void mp_write_uint(struct mp_writer *w, uint64_t value);
void mp_write_str(struct mp_writer *w, const char *str);
void mp_write_nil(struct mp_writer *w);
```

## src/rpc.c
```c
#include "rpc.h"

#include <stdbool.h>
#include <stdio.h>
#include <string.h>

#include "mpack.h"

enum { REQUEST = 0, RESPONSE = 1, NOTIFICATION = 2 };

static const char *const methods[] = {"notes/status", "notes/text", "notes/hello"};

static const struct rpc_callbacks *cb;
static uint8_t rx[512];
static size_t rx_len;
static uint32_t next_id = 1;

void rpc_init(const struct rpc_callbacks *callbacks)
{
	cb = callbacks;
	rx_len = 0;
}

static void send(struct mp_writer *w)
{
	if (w->ok) {
		cb->write(w->buf, w->len);
	}
}

void rpc_register(void)
{
	uint8_t buf[64];
	struct mp_writer w;

	for (size_t i = 0; i < sizeof(methods) / sizeof(methods[0]); i++) {
		mp_writer_init(&w, buf, sizeof(buf));
		mp_write_array(&w, 4);
		mp_write_uint(&w, REQUEST);
		mp_write_uint(&w, next_id++);
		mp_write_str(&w, "$/register");
		mp_write_array(&w, 1);
		mp_write_str(&w, methods[i]);
		send(&w);
	}
}

static void respond(uint64_t id, const char *error, const char *result)
{
	uint8_t buf[96];
	struct mp_writer w;

	mp_writer_init(&w, buf, sizeof(buf));
	mp_write_array(&w, 4);
	mp_write_uint(&w, RESPONSE);
	mp_write_uint(&w, id);
	if (error) {
		mp_write_str(&w, error);
	} else {
		mp_write_nil(&w);
	}
	if (result) {
		mp_write_str(&w, result);
	} else {
		mp_write_nil(&w);
	}
	send(&w);
}

static bool method_is(const char *m, uint32_t len, const char *name)
{
	return len == strlen(name) && memcmp(m, name, len) == 0;
}

static void on_status(struct mp_reader *r)
{
	uint32_t n;
	const char *state;
	uint32_t state_len;
	int64_t requests, uploads;

	if (mp_read_array(r, &n) && n == 3 && mp_read_str(r, &state, &state_len) && state_len == 1 &&
	    mp_read_int(r, &requests) && mp_read_int(r, &uploads)) {
		cb->status(state[0], requests, uploads);
	}
}

static void on_text(struct mp_reader *r)
{
	uint32_t n;
	const char *text;
	uint32_t len;

	if (mp_read_array(r, &n) && n == 1 && mp_read_str(r, &text, &len)) {
		cb->text(text, len);
	}
}

/* One complete message of `len` bytes. */
static void dispatch(const uint8_t *msg, size_t len)
{
	struct mp_reader r;
	uint32_t n;
	int64_t type, id;
	const char *method;
	uint32_t method_len;

	mp_reader_init(&r, msg, len);
	if (!mp_read_array(&r, &n) || !mp_read_int(&r, &type)) {
		return;
	}
	if (type == NOTIFICATION && n == 3 && mp_read_str(&r, &method, &method_len)) {
		if (method_is(method, method_len, "notes/status")) {
			on_status(&r);
		} else if (method_is(method, method_len, "notes/text")) {
			on_text(&r);
		}
	} else if (type == REQUEST && n == 4 && mp_read_int(&r, &id) &&
		   mp_read_str(&r, &method, &method_len)) {
		if (method_is(method, method_len, "notes/hello")) {
			respond((uint64_t)id, NULL, RPC_HELLO);
		} else {
			respond((uint64_t)id, "method not supported by notes-matrix", NULL);
		}
	} else if (type == RESPONSE && n == 4 && mp_read_int(&r, &id)) {
		/* Replies to our $/register calls: only errors are interesting. */
		if (!mp_read_nil(&r) && cb->log) {
			/* The router's errors are [code, message]; others may send a string. */
			struct mp_reader as_array = r;
			const char *err = NULL;
			uint32_t err_len = 0, count;
			int64_t code;
			char line[96];

			if (mp_read_array(&as_array, &count) && count == 2 &&
			    mp_read_int(&as_array, &code) && mp_read_str(&as_array, &err, &err_len)) {
				/* err set */
			} else if (!mp_read_str(&r, &err, &err_len)) {
				err = NULL;
			}
			if (err) {
				snprintf(line, sizeof(line), "router error: %.*s", (int)err_len, err);
			} else {
				snprintf(line, sizeof(line), "router error for request %lld", (long long)id);
			}
			cb->log(line);
		}
	}
}

void rpc_feed(const uint8_t *buf, size_t len)
{
	while (len > 0) {
		size_t n = sizeof(rx) - rx_len;

		if (n > len) {
			n = len;
		}
		memcpy(rx + rx_len, buf, n);
		rx_len += n;
		buf += n;
		len -= n;

		/* Consume every complete message; drop bytes that can't start one. */
		size_t pos = 0;

		while (pos < rx_len) {
			int m = mp_value_len(rx + pos, rx_len - pos);

			if (m > 0) {
				dispatch(rx + pos, (size_t)m);
				pos += (size_t)m;
			} else if (m < 0) {
				pos += 1; /* garbage: resynchronise */
			} else if (pos == 0 && rx_len == sizeof(rx)) {
				pos = rx_len; /* one message bigger than our buffer: discard */
			} else {
				break; /* incomplete: wait for more bytes */
			}
		}
		memmove(rx, rx + pos, rx_len - pos);
		rx_len -= pos;
	}
}
```

## src/rpc.h
```c
/*
 * MessagePack-RPC through arduino-router, implemented directly (no Arduino
 * Bridge library). Plain C: I/O goes through the callbacks, so it can be
 * tested on a PC.
 *
 * The router forwards calls and notifications for a method to the client that
 * registered it with `$/register`. This firmware registers:
 *
 *   notes/status   notification  [state, requests, uploads]
 *                  state: "B" starting, "O" ok, "W" warning, "E" error, "D" stopping
 *   notes/text     notification  [text]         scroll text once
 *   notes/hello    request       []  -> RPC_HELLO
 *
 * Messages: request [0, id, method, params], response [1, id, error, result],
 * notification [2, method, params], as one continuous MessagePack stream.
 */
#pragma once

#include <stddef.h>
#include <stdint.h>

#define RPC_HELLO "notes-matrix 3"

struct rpc_callbacks {
	void (*write)(const uint8_t *buf, size_t len);
	void (*status)(char state, int64_t requests, int64_t uploads);
	void (*text)(const char *text, size_t len);
	void (*log)(const char *msg);
};

void rpc_init(const struct rpc_callbacks *cb);

/* Sends `$/register` for every method (safe to repeat: re-registering is a no-op). */
void rpc_register(void);

/* Feeds received bytes. */
void rpc_feed(const uint8_t *buf, size_t len);
```

## src/view.c
```c
/*
 * Views:
 *   waiting for the server  dim dot sweeping along the bottom row
 *   starting (B)            spinning comet
 *   ok (O)                  bar graph of requests/second over the last 13 s
 *                           (log scale, bright tops where images were
 *                           uploaded) and a heartbeat pixel top-right
 *   warning (W)             the same graph with the top row blinking
 *   error (E)               solid X
 *   server down             blinking X: no status line for 5 s (crash/hang)
 *   stopped (D)             dim dash: clean shutdown
 *   upload                  arrow flying up
 *   text                    scrolls across, then the normal view returns
 */

#include "view.h"

#include <stdbool.h>
#include <stdlib.h>
#include <string.h>

#define W MATRIX_W
#define H MATRIX_H

#define DOWN_AFTER_MS   5000u
#define SCROLL_STEP_MS  70u
#define UPLOAD_ANIM_MS  900u
#define HEARTBEAT_MS    400u

static struct {
	char state; /* 0 = never heard from the server */
	uint32_t last_status_ms;
	uint16_t requests[W]; /* per second, oldest first */
	uint16_t uploads[W];
	bool upload_anim;
	uint32_t upload_anim_start;
	char text[64];
	int text_len;
	int text_x;
	bool text_active;
	uint32_t last_scroll_ms;
} s;

/* 3x5 font: 5 rows of 3 bits, bit 2 = left column. */
struct glyph {
	char c;
	uint8_t rows[5];
};

static const struct glyph font[] = {
	{'0', {7, 5, 5, 5, 7}}, {'1', {2, 6, 2, 2, 7}}, {'2', {7, 1, 7, 4, 7}},
	{'3', {7, 1, 7, 1, 7}}, {'4', {5, 5, 7, 1, 1}}, {'5', {7, 4, 7, 1, 7}},
	{'6', {7, 4, 7, 5, 7}}, {'7', {7, 1, 2, 2, 2}}, {'8', {7, 5, 7, 5, 7}},
	{'9', {7, 5, 7, 1, 7}}, {'A', {2, 5, 7, 5, 5}}, {'B', {6, 5, 6, 5, 6}},
	{'C', {3, 4, 4, 4, 3}}, {'D', {6, 5, 5, 5, 6}}, {'E', {7, 4, 6, 4, 7}},
	{'F', {7, 4, 6, 4, 4}}, {'G', {3, 4, 5, 5, 3}}, {'H', {5, 5, 7, 5, 5}},
	{'I', {7, 2, 2, 2, 7}}, {'J', {1, 1, 1, 5, 2}}, {'K', {5, 5, 6, 5, 5}},
	{'L', {4, 4, 4, 4, 7}}, {'M', {5, 7, 5, 5, 5}}, {'N', {6, 5, 5, 5, 5}},
	{'O', {2, 5, 5, 5, 2}}, {'P', {6, 5, 6, 4, 4}}, {'Q', {2, 5, 5, 6, 3}},
	{'R', {6, 5, 6, 5, 5}}, {'S', {3, 4, 2, 1, 6}}, {'T', {7, 2, 2, 2, 2}},
	{'U', {5, 5, 5, 5, 7}}, {'V', {5, 5, 5, 5, 2}}, {'W', {5, 5, 5, 7, 5}},
	{'X', {5, 5, 2, 5, 5}}, {'Y', {5, 5, 2, 2, 2}}, {'Z', {7, 1, 2, 4, 7}},
	{'.', {0, 0, 0, 0, 2}}, {':', {0, 2, 0, 2, 0}}, {'-', {0, 0, 7, 0, 0}},
	{'/', {1, 1, 2, 4, 4}}, {'!', {2, 2, 2, 0, 2}}, {'%', {5, 1, 2, 4, 5}},
};

static const uint8_t *glyph_rows(char c)
{
	static const uint8_t blank[5];

	for (size_t i = 0; i < sizeof(font) / sizeof(font[0]); i++) {
		if (font[i].c == c) {
			return font[i].rows;
		}
	}
	return blank;
}

static uint8_t *fb_;

static void px(int x, int y, uint8_t level)
{
	if (x >= 0 && x < W && y >= 0 && y < H && level > fb_[y * W + x]) {
		fb_[y * W + x] = level;
	}
}

static void draw_x(void)
{
	for (int i = 0; i < H; i++) {
		px(3 + i, i, MATRIX_MAX);
		px(10 - i, i, MATRIX_MAX);
	}
}

static void view_waiting(uint32_t now)
{
	int pos = (int)((now / 120) % (2 * (W - 1)));

	px(pos < W ? pos : 2 * (W - 1) - pos, H - 1, 2);
}

static void view_starting(uint32_t now)
{
	/* 12 points on a circle around the matrix centre. */
	static const int8_t ring[12][2] = {
		{6, 0}, {8, 1}, {9, 2}, {9, 4}, {9, 5}, {8, 6},
		{6, 7}, {4, 6}, {3, 5}, {3, 4}, {3, 2}, {4, 1},
	};
	int head = (int)((now / 70) % 12);

	for (int k = 0; k < 5; k++) {
		int i = (head - k + 12) % 12;

		px(ring[i][0], ring[i][1], (uint8_t)(MATRIX_MAX - k));
	}
}

static int bar_height(uint16_t n)
{
	int h = 0;

	if (n > 0) { /* log2 scale: 1, 2-3, 4-7, ... 64+ */
		h = 1;
		while (n > 1 && h < H - 1) {
			n >>= 1;
			h++;
		}
	}
	return h;
}

static void view_dashboard(uint32_t now, bool warning)
{
	for (int x = 0; x < W; x++) {
		int h = bar_height(s.requests[x]);

		for (int i = 0; i < h; i++) {
			px(x, H - 1 - i, 2);
		}
		if (s.uploads[x] > 0) {
			px(x, H - 1 - (h > 0 ? h - 1 : 0), MATRIX_MAX);
		}
	}
	if (warning && (now / 500) % 2 == 0) {
		for (int x = 0; x < W; x++) {
			px(x, 0, MATRIX_MAX);
		}
	}
	uint32_t since = now - s.last_status_ms;

	if (since < HEARTBEAT_MS) {
		px(W - 1, 0, (uint8_t)(MATRIX_MAX - since * MATRIX_MAX / HEARTBEAT_MS));
	}
}

static void view_upload(uint32_t now)
{
	static const uint8_t arrow[5] = {0x04, 0x0e, 0x15, 0x04, 0x04}; /* 5 wide */
	int top = H - (int)((now - s.upload_anim_start) * (H + 5) / UPLOAD_ANIM_MS);

	for (int r = 0; r < 5; r++) {
		for (int c = 0; c < 5; c++) {
			if (arrow[r] & (0x10 >> c)) {
				px(4 + c, top + r, MATRIX_MAX);
			}
		}
	}
}

static void draw_text(void)
{
	for (int i = 0; i < s.text_len; i++) {
		const uint8_t *g = glyph_rows(s.text[i]);
		int gx = s.text_x + i * 4;

		if (gx >= W || gx + 3 < 0) {
			continue;
		}
		for (int r = 0; r < 5; r++) {
			for (int c = 0; c < 3; c++) {
				if (g[r] & (4 >> c)) {
					px(gx + c, 1 + r, MATRIX_MAX);
				}
			}
		}
	}
}

static void push_history(uint16_t requests, uint16_t uploads)
{
	memmove(s.requests, s.requests + 1, (W - 1) * sizeof(s.requests[0]));
	memmove(s.uploads, s.uploads + 1, (W - 1) * sizeof(s.uploads[0]));
	s.requests[W - 1] = requests;
	s.uploads[W - 1] = uploads;
}

static uint16_t clamp_u16(int64_t v)
{
	return v < 0 ? 0 : v > 65535 ? 65535 : (uint16_t)v;
}

void view_init(void)
{
	memset(&s, 0, sizeof(s));
}

void view_status(char state, int64_t requests, int64_t uploads, uint32_t now)
{
	if (strchr("BOWED", state) == NULL || state == '\0') {
		return;
	}
	if (state == 'O' || state == 'W') {
		push_history(clamp_u16(requests), clamp_u16(uploads));
	}
	if (uploads > 0 && !s.upload_anim) {
		s.upload_anim = true;
		s.upload_anim_start = now;
	}
	s.state = state;
	s.last_status_ms = now;
}

void view_text(const char *text, size_t len, uint32_t now)
{
	if (len > sizeof(s.text) - 1) {
		len = sizeof(s.text) - 1;
	}
	memcpy(s.text, text, len);
	s.text[len] = '\0';
	s.text_len = (int)len;
	s.text_x = W;
	s.text_active = len > 0;
	s.last_scroll_ms = now;
}

uint32_t view_last_status_ms(void)
{
	return s.state ? s.last_status_ms : 0;
}

void view_render(uint8_t fb[MATRIX_LEDS], uint32_t now)
{
	fb_ = fb;
	memset(fb, 0, MATRIX_LEDS);

	while (s.text_active && now - s.last_scroll_ms >= SCROLL_STEP_MS) {
		s.last_scroll_ms += SCROLL_STEP_MS;
		if (--s.text_x < -s.text_len * 4) {
			s.text_active = false;
		}
	}
	if (s.upload_anim && now - s.upload_anim_start >= UPLOAD_ANIM_MS) {
		s.upload_anim = false;
	}

	bool down = s.state != 0 && s.state != 'D' && now - s.last_status_ms > DOWN_AFTER_MS;

	if (down) {
		if ((now / 500) % 2 == 0) {
			draw_x();
		}
	} else if (s.text_active) {
		draw_text();
	} else if (s.upload_anim) {
		view_upload(now);
	} else {
		switch (s.state) {
		case 0:
			view_waiting(now);
			break;
		case 'B':
			view_starting(now);
			break;
		case 'O':
			view_dashboard(now, false);
			break;
		case 'W':
			view_dashboard(now, true);
			break;
		case 'E':
			draw_x();
			break;
		case 'D':
			for (int x = 4; x <= 8; x++) {
				px(x, 3, 2);
				px(x, 4, 2);
			}
			break;
		}
	}
}
```

## src/view.h
```c
/*
 * What the matrix shows, driven by notes-server's status updates (delivered
 * by rpc.c). Plain C (no Zephyr APIs) so it can be compiled and tested on a PC.
 */
#pragma once

#include <stddef.h>
#include <stdint.h>

#include "matrix.h"

void view_init(void);

/* A status update: state 'B' starting, 'O' ok, 'W' warning, 'E' error, 'D' stopping. */
void view_status(char state, int64_t requests, int64_t uploads, uint32_t now_ms);

/* Scrolls `text` once. */
void view_text(const char *text, size_t len, uint32_t now_ms);

/* When the last status update arrived (0 = never). */
uint32_t view_last_status_ms(void);

/* Draws the current view into `fb` (row-major brightness 0..7). */
void view_render(uint8_t fb[MATRIX_LEDS], uint32_t now_ms);
```
